/**
 * @file main.c
 * @brief Main application entry point for the Embedded MIDI Step Sequencer.
 *
 * This file initializes all hardware and software modules used by the
 * sequencer system and runs the foreground loop. The foreground loop is
 * responsible for scanning user inputs, processing non-time-critical events,
 * updating display outputs, and responding to flags generated by the timer
 * sequencing engine.
 *
 * Current control mapping in the implemented firmware:
 * - Tiva SW1 toggles playback
 * - Tiva SW2 is reserved for future shift/alternate behavior
 * - EduBase SW2-SW5 select tracks 1-4
 * - Keypad K0-K15 toggle steps for the selected track
 */

#include <stdint.h>
#include <stdbool.h>
#include "TM4C123GH6PM.h"

#include "sequencer.h"
#include "buttons.h"
#include "keypad.h"
#include "lcd.h"
#include "display7seg.h"
#include "timer_seq.h"
#include "midi_uart.h"
#include "gpio.h"
#include "SysTick_Delay.h"

int main(void)
{
    // Initialize all project modules
    GPIO_ProjectInit();
    Buttons_Init();
    Keypad_Init();
    SysTick_Delay_Init();
    LCD_Init();
    Display7Seg_Init();
    MIDI_UART_Init();
    Sequencer_Init();
    TimerSeq_Init(120U);

    // Initial UI state
    LCD_Clear();
    LCD_DisplayTrackSteps(Sequencer_GetCurrentTrack(), Sequencer_GetCurrentStep());
    GPIO_ClearAllTrackLEDs();
    GPIO_SetTrackLED(Sequencer_GetCurrentTrack(), true);

    while (1)
    {
        int8_t key;

        // Update button state machine / debounce logic
        Buttons_Update();

        // Scan keypad
        key = Keypad_Scan();
        if (key >= 0)
        {
            Sequencer_ToggleStep(Sequencer_GetCurrentTrack(), (uint8_t)key);
            LCD_DisplayTrackSteps(Sequencer_GetCurrentTrack(), Sequencer_GetCurrentStep());
        }

        // Transport control: Tiva SW1 toggles playback in the current firmware.
        if (Buttons_WasTivaSW1Pressed())
        {
            Sequencer_TogglePlay();

            if (Sequencer_IsPlaying())
                {
                    TimerSeq_Start();
                }
        else
            {
                TimerSeq_Stop();
            }
        }
				
        // Track selection
        if (Buttons_WasEduBaseSW5Pressed())
        {
            Sequencer_SelectTrack(3U);
            GPIO_ClearAllTrackLEDs();
            GPIO_SetTrackLED(Sequencer_GetCurrentTrack(), true);
            LCD_DisplayTrackSteps(Sequencer_GetCurrentTrack(), Sequencer_GetCurrentStep());
        }

        if (Buttons_WasEduBaseSW4Pressed())
        {
            Sequencer_SelectTrack(2U);
            GPIO_ClearAllTrackLEDs();
            GPIO_SetTrackLED(Sequencer_GetCurrentTrack(), true);
            LCD_DisplayTrackSteps(Sequencer_GetCurrentTrack(), Sequencer_GetCurrentStep());
        }

        if (Buttons_WasEduBaseSW3Pressed())
        {
            Sequencer_SelectTrack(1U);
            GPIO_ClearAllTrackLEDs();
            GPIO_SetTrackLED(Sequencer_GetCurrentTrack(), true);
            LCD_DisplayTrackSteps(Sequencer_GetCurrentTrack(), Sequencer_GetCurrentStep());
        }

        if (Buttons_WasEduBaseSW2Pressed())
        {
            Sequencer_SelectTrack(0U);
            GPIO_ClearAllTrackLEDs();
            GPIO_SetTrackLED(Sequencer_GetCurrentTrack(), true);
            LCD_DisplayTrackSteps(Sequencer_GetCurrentTrack(), Sequencer_GetCurrentStep());
        }

        // Update BPM display
        Display7Seg_ShowNumber(Sequencer_GetBPM());

        // React to the one-shot step event generated by the timer ISR.
        if (Sequencer_HasStepAdvanced())
        {
            uint8_t track;
            uint8_t step;

            step = Sequencer_GetCurrentStep();

            for (track = 0U; track < 4U; track++)
            {
                if (Sequencer_GetStepState(track, step) != 0U)
                {
                    // The current application sends immediate Note On/Off pairs.
                    MIDI_UART_SendNoteOn(0U, Sequencer_GetMidiNoteForTrack(track), 100U);
                    MIDI_UART_SendNoteOff(0U, Sequencer_GetMidiNoteForTrack(track), 0U);
                    GPIO_BlinkTrackLED(track);
                }
            }

            LCD_DisplayTrackSteps(Sequencer_GetCurrentTrack(), step);
        }
    }
}
